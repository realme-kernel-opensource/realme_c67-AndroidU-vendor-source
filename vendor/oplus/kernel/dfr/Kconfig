## vendor/oplus/kernel/dfr/Kconfig
```kconfig
# SPDX-License-Identifier: GPL-2.0-only
# Copyright (C) 2018-2022 Oplus. All rights reserved.

#ifdef OPLUS_FEATURE_QCOM_WATCHDOG
source "drivers/soc/oplus/dfr/qcom/qcom_watchdog/Kconfig"
#endif /* OPLUS_FEATURE_QCOM_WATCHDOG */

#ifdef OPLUS_FEATURE_DUMP_DEVICE_INFO
source "drivers/soc/oplus/dfr/qcom/dump_device_info/Kconfig"
#endif /* OPLUS_FEATURE_DUMP_DEVICE_INFO */

source "drivers/soc/oplus/dfr/common/shutdown_detect/Kconfig"

source "drivers/soc/oplus/dfr/qcom/qcom_watchdog/Kconfig"

source "drivers/soc/oplus/dfr/qcom/qcom_pmicwd/Kconfig"

source "drivers/soc/oplus/dfr/qcom/qcom_pmic_monitor/Kconfig"

source "drivers/soc/oplus/dfr/common/hung_task_enhance/Kconfig"
```

## vendor/oplus/kernel/touchpanel/oplus_touchscreen_v2/Himax/hx83102j_noflash/Kconfig
```kconfig
#ifdef OPLUS_FEATURE_TP_BASIC
#Added by ZhongWenjie@Bsp.group.Tp for himax hx833112A NOFLASH ic driver

config TOUCHPANEL_HIMAX_HX83102J_NOFLASH
#	default y
	tristate "TP himax hx83102j no-flash IC enable or not for OPLUS"
	help
	Say Y to enable driver for Touchpanel useing himax hx83102j no-flash
	Say M to enable driver for Touchpanel useing himax hx83102j no-flash as module

#endif
```
